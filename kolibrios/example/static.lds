SECTIONS
{
    . = 0x10000; /* Устанавливаем начальный адрес для KolibriOS */
    
    .text :
    {
        /* Заголовок для KolibriOS */
        LONG(0x554e454D); /* Signature "MENU" */
        LONG(0x31305445); /* Signature "ET01" */
        LONG(1);          /* Версия */
        LONG(go_0example.Main); /* Точка входа программы */
        LONG(__end);      /* Конец образа */
        LONG(0x10000);    /* Размер стека */
        LONG(0x10000);    /* Размер стека */
        LONG(0);          /* Зарезервировано */
        LONG(0);          /* Зарезервировано */
        
        *(.text)         /* Все текстовые (исполняемые) данные */
    }
    
    .rodata :
    {
        *(.rodata)       /* Данные только для чтения */
        *(.rodata.*)     /* Дополнительные секции данных для чтения */
    }
    
    .data :
    {
        *(.data)         /* Инициализированные данные */
    }
    
    .bss :
    {
        *(COMMON)        /* Общие данные */
        *(.bss)          /* Неинициализированные данные */
    }

    .eh_frame :
    {
        *(.eh_frame)     /* Информация о стеке (для исключений) */
    }
    
    .group :
    {
        *(.group)        /* Специфическая группа данных */
    }

    __end = .;          /* Определяем конец образа */
}
